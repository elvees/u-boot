## board/elvees/Kconfig
```kconfig
config SYS_VENDOR
	default "elvees"

if ARCH_MCOM03

choice
	prompt "MCom-03/MCom-03R board select"

config TARGET_HAPS
	bool "HAPS"
	select DM_ETH
	select DM_MMC
	help
	  Support for HAPS prototype for MCom-03.

config TARGET_MCOM03
	bool "MCom-03"
	select DM_ETH
	select DM_MMC
	select DM_GPIO
	help
	  Support for all MCom-03 based boards, except MCom-03 ECAM03.

config TARGET_MCOM03_ECAM03
	bool "MCom-03 ECAM03"
	select DM_ETH
	select DM_MMC
	select DM_GPIO
	help
	  Support for MCom-03 ECAM03 boards.

config TARGET_MCOM03_ECAM03_RECOVERY
	bool "MCom-03 ECAM03 recovery"
	select DM_ETH
	select DM_MMC
	select DM_GPIO
	help
	  Support for MCom-03 ECAM03 recovery boot.

config TARGET_MCOM03R
	bool "MCom-03R"
	select DM_ETH
	select DM_MMC
	select DM_GPIO
	help
	  Support for all MCom-03R based boards, except MCom-03R ECAM03.

config TARGET_MCOM03R_ECAM03
	bool "MCom-03R ECAM03"
	select DM_ETH
	select DM_MMC
	select DM_GPIO
	help
	  Support for MCom-03R ECAM03 boards.

config TARGET_MCOM03R_ECAM03_RECOVERY
	bool "MCom-03R ECAM03 recovery"
	select DM_ETH
	select DM_MMC
	select DM_GPIO
	help
	  Support for MCom-03R ECAM03 recovery boot.

endchoice

config SYS_SOC
        default "mcom03" if TARGET_MCOM03
	default "mcom03" if TARGET_MCOM03_ECAM03
	default "mcom03" if TARGET_MCOM03_ECAM03_RECOVERY
	default "mcom03r" if TARGET_MCOM03R
	default "mcom03r" if TARGET_MCOM03R_ECAM03
	default "mcom03r" if TARGET_MCOM03R_ECAM03_RECOVERY

source "board/elvees/common/Kconfig"

config SETUP_MEMORY_TAGS
	bool "Enable memory tag"
	depends on !ENV_IS_IN_UBI
	default y
	help
	  Describe memory regions for the kernel.

config CMDLINE_TAG
	bool "Enable passing of ATAGs"
	default y
	help
	  This ensures that U-Boot will boot the kernel with
	  a command-line tag that incorporates the kernel options
	  you set in the "bootargs" environment variable.

config MCOM03_EXTERNAL_DTB_ADDR
	hex "External DTB memory address"
	default 0x890402000
	default 0xD0000000 if TARGET_HAPS
	help
	  This option contains memory address where U-Boot tries to
	  find external DTB, which can be passed by previous bootloader.

config MCOM03_XTAL_FREQ
	int "XTAL frequency"
	default 27000000

config MEM_REGIONS_ADDR
	hex "Address to read DDR info from"
	default 0x890400000
	help
	  Address to read DDR memory bank sizes and start addresses
	  from (written by ddrinit).

config DDRMC_MAX_NUMBER
	int
	default 2
	help
	  Number of DDR controllers

config FDTFILE
	string
	help
	  Default value for fdtfile variable.

config MCOM03_EMMC_BOOT_WP_DISABLED
	bool "Disable write protection of eMMC boot0 partition"
	default n
	help
	  This ensures that U-Boot will boot the kernel without
	  the Power-On write protection of eMMC boot0 partition.

config MCOM03_DISABLE_FACTORY
	bool "Disable factory settings"
	default n
	help
	  This ensures that U-Boot will boot without factory settings
	  applied.

endif
```

## board/elvees/common/Kconfig
```kconfig
config SYS_BOARD
	default "common"

if TARGET_MCOM03 || TARGET_MCOM03R || TARGET_HAPS

config SYS_CONFIG_NAME
	default "mcom03"

endif

if TARGET_MCOM03_ECAM03 || TARGET_MCOM03R_ECAM03

config SYS_CONFIG_NAME
	default "mcom03-ecam03"

endif

if TARGET_MCOM03_ECAM03_RECOVERY || TARGET_MCOM03R_ECAM03_RECOVERY

config SYS_CONFIG_NAME
	default "mcom03-ecam03-recovery"

endif
```

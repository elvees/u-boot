## arch/arm/cpu/armv7/mcom/Kconfig
```kconfig
if ARCH_MCOM

config BOOT_ELF_FROM_SPI
	bool "Enable ELF file booting from SPI"
	help
	  After U-boot is started the following operation will be
	  performed:
	  * ELF file of the application will be loaded from SPI flash
	    to RAM.
	  * Application in ELF file will be launched automatically.

config HW_WATCHDOG
	bool "Enable watchdog at startup"
	select SPL_WATCHDOG_SUPPORT
	default no
	help
	  Enable watchdog timer for SPL and U-Boot

config DEBUG_DDR
	bool "Enable DDR debug printing"
	default no
	help
	  Print debug information during DDR initialization

menu "DDR calibration mode"

config DDR_CALIBRATION
	bool "Enable DDR calibration mode"
	select HW_WATCHDOG
	default no
	help
	  In DDR calibration mode U-Boot SPL tries to read calibration
	  parameters from VRAM and initializes DDR according to this parameters.
	  If parameters read is failed U-Boot SPL initializes DDR as usual.

config DEBUG_DDR_CALIBRATION
	bool "Enable debug printing in DDR calibration"
	default no
	help
	  Print debug information during DDR calibration

endmenu

config SYS_SOC
	default "mcom"

source "board/elvees/Kconfig"

endif
```

## board/elvees/ecam02dm/Kconfig
```kconfig
if TARGET_ECAM02DM || TARGET_ECAM02DM3 || TARGET_ECAM02DM31

config SYS_BOARD
	default "ecam02dm"

config SYS_CONFIG_NAME
	default "mcom"

endif
```

## board/elvees/ecam03bl/Kconfig
```kconfig
if TARGET_ECAM03BL

config SYS_BOARD
	default "ecam03bl"

config SYS_CONFIG_NAME
	default "mcom03-ecam03"

config ECAM03_DEFAULT_DTB_FILE_NAME
	default "mcom03-ecam03bl-r1.0"

endif
```

## board/elvees/ecam03dm/Kconfig
```kconfig
if TARGET_ECAM03DM

config SYS_BOARD
	default "ecam03dm"

config SYS_CONFIG_NAME
	default "mcom03-ecam03"

config ECAM03_DEFAULT_DTB_FILE_NAME
	default "mcom03-ecam03dm-r1.0"

endif
```

## board/elvees/ecam03ptz/Kconfig
```kconfig
if TARGET_ECAM03PTZ

config SYS_BOARD
	default "ecam03ptz"

config SYS_CONFIG_NAME
	default "mcom03-ecam03"

endif
```

## board/elvees/elvmc03cb/Kconfig
```kconfig
if TARGET_MCOM03_ELVMC03CB

config SYS_BOARD
	default "elvmc03cb"

config SYS_CONFIG_NAME
	default "mcom03"

endif
```

## board/elvees/elvmc03q7/Kconfig
```kconfig
if TARGET_MCOM03_ELVMC03Q7

config SYS_BOARD
	default "elvmc03q7"

config SYS_CONFIG_NAME
	default "mcom03"

endif
```

## board/elvees/elvmc03smarc/Kconfig
```kconfig
if TARGET_ELVMC03SMARC

config SYS_BOARD
	default "elvmc03smarc"

config SYS_CONFIG_NAME
	default "mcom03"

endif
```

## board/elvees/haps/Kconfig
```kconfig
if TARGET_HAPS

config SYS_BOARD
	default "haps"

config SYS_CONFIG_NAME
	default "mcom03-haps"

endif
```

## board/elvees/ipku/Kconfig
```kconfig
if TARGET_IPKU || TARGET_IPKU2 || TARGET_MCOM02_UKF

config SYS_BOARD
	default "ipku"

config SYS_CONFIG_NAME
	default "mcom"

endif
```

## board/elvees/mcom/Kconfig
```kconfig
config SYS_CONFIG_NAME
	default "mcom"

config SYS_VENDOR
	default "elvees"

config SYS_BOARD
	default "mcom"

choice
	prompt "MCom board select"

config TARGET_SALUTE
	bool "Salute"
	select SUPPORT_SPL
	help
	  Support for the following boards:
	    Salute-EL24D1
	    Salute-EL24D2
	    SBC-DBG
	    SBC-VM
	    VIP1-3D-OV7725
	    VIP1-EVA
	    VIP1-MC802
	    VIP1-MC805

config TARGET_IPKU
	bool "IP-KU"
	select SUPPORT_SPL
	help
	  Support for IP-KU board

endchoice

config FDTFILE
	string "Default fdtfile env setting for this board"

config CONS_INDEX
	int "UART for messages output"
	default 1
	help
	  1 for UART0, 2 for UART1, etc

config DDR_SIZE_IN_MB
	int "DDR size in MB"
	default 1024
```

## board/elvees/mcom03-bub/Kconfig
```kconfig
if TARGET_MCOM03_BUB

config SYS_BOARD
	default "mcom03-bub"

config SYS_CONFIG_NAME
	default "mcom03"

endif
```

## board/elvees/ngfw-cb/Kconfig
```kconfig
if TARGET_MCOM03_NGFWCB

config SYS_BOARD
	default "ngfw-cb"

config SYS_CONFIG_NAME
	default "mcom03"

endif
```

## board/elvees/pm03cam/Kconfig
```kconfig
if TARGET_PM03CAM

config SYS_BOARD
	default "pm03cam"

config SYS_CONFIG_NAME
	default "mcom03-ecam03"

endif
```

## board/elvees/rtl/Kconfig
```kconfig
if TARGET_RTL

config SYS_BOARD
	default "rtl"

config SYS_CONFIG_NAME
	default "mcom03-rtl"

config MTRAN_ADDRESS
	hex "MTRAN base address"
	default 0xF0001000

endif
```

## board/elvees/salute-d1/Kconfig
```kconfig
if TARGET_SALUTE_D1

config SYS_BOARD
	default "salute-d1"

config SYS_CONFIG_NAME
	default "mcom"

endif
```

## board/elvees/salute-d2/Kconfig
```kconfig
if TARGET_SALUTE_D2

config SYS_BOARD
	default "salute-d2"

config SYS_CONFIG_NAME
	default "mcom"

endif
```

## board/elvees/salute-pm/Kconfig
```kconfig
if TARGET_SALUTE_PM

config SYS_BOARD
	default "salute-pm"

config SYS_CONFIG_NAME
	default "mcom"

endif
```

## board/elvees/salute/Kconfig
```kconfig
if TARGET_SALUTE

config SYS_BOARD
	default "salute"

config SYS_CONFIG_NAME
	default "mcom"

endif
```

## board/elvees/sbcvm/Kconfig
```kconfig
if TARGET_SBCVM

config SYS_CONFIG_NAME
	default "sbcvm"

config SYS_BOARD
	default "sbcvm"

config FDTFILE
	string "Default fdtfile env setting for this board"

config CONS_INDEX
	int "UART for messages output"
	default 1
	---help---
	1 for UART0, 2 for UART1, etc

config DDR_SIZE_IN_MB
	int "DDR size in MB"
	default 1024

endif
```

## board/elvees/trustphonepm/Kconfig
```kconfig
if TARGET_MCOM03_TRUSTPHONEPM

config SYS_BOARD
	default "trustphonepm"

config SYS_CONFIG_NAME
	default "mcom03"

endif
```

## configs/ecam03_defconfig
```kconfig
CONFIG_ARM=y
CONFIG_ARCH_MCOM03=y
CONFIG_TEXT_BASE=0x890480000
CONFIG_SYS_MALLOC_F_LEN=0x4000
CONFIG_HAS_CUSTOM_SYS_INIT_SP_ADDR=y
CONFIG_CUSTOM_SYS_INIT_SP_ADDR=0x890800000
CONFIG_TARGET_MCOM03_ECAM03=y
CONFIG_ENV_SIZE=0x10000
CONFIG_ENV_OFFSET=0xFE0000
CONFIG_ENV_SECT_SIZE=0x10000
CONFIG_DEFAULT_DEVICE_TREE="mcom03-ecam03bl-r1.0"
CONFIG_DM_RESET=y
CONFIG_ARMV8_SET_SMPEN=y
CONFIG_STANDALONE_LOAD_ADDR=0x892400000
CONFIG_DISTRO_DEFAULTS=y
# CONFIG_DISPLAY_CPUINFO is not set
CONFIG_BOARD_LATE_INIT=y
CONFIG_MISC_INIT_R=y
CONFIG_CMD_NVEDIT_APPEND=y
CONFIG_CMD_MEMINFO=y
CONFIG_CMD_GPT=y
# CONFIG_RANDOM_UUID is not set
CONFIG_CMD_MMC=y
CONFIG_CMD_MTD=y
CONFIG_CMD_SF_TEST=y
CONFIG_CMD_SPI=y
CONFIG_CMD_SQUASHFS=y
# CONFIG_ISO_PARTITION is not set
CONFIG_OF_BOARD=y
CONFIG_OF_OMIT_DTB=y
CONFIG_ENV_IS_IN_SPI_FLASH=y
CONFIG_NET_RANDOM_ETHADDR=y
CONFIG_DWAPB_GPIO=y
CONFIG_MMC_IO_VOLTAGE=y
CONFIG_MMC_HS200_SUPPORT=y
CONFIG_MMC_SDHCI=y
CONFIG_MMC_SDHCI_ADMA=y
CONFIG_MMC_SDHCI_MCOM03=y
CONFIG_MTD=y
CONFIG_DM_MTD=y
CONFIG_MTD_RAW_NAND=y
CONFIG_NAND_ARASAN=y
CONFIG_DM_SPI_FLASH=y
CONFIG_SPI_FLASH_SPANSION=y
CONFIG_SPI_FLASH_WINBOND=y
CONFIG_PHY_MICREL=y
CONFIG_PHY_MICREL_KSZ90X1=y
CONFIG_PHY_REALTEK=y
CONFIG_ARASAN_GEMAC=y
CONFIG_DM_REGULATOR=y
CONFIG_DM_REGULATOR_FIXED=y
CONFIG_RESET_MCOM03=y
CONFIG_SYS_NS16550=y
CONFIG_SPI=y
CONFIG_DM_SPI=y
CONFIG_SILVACO_QSPI=y
CONFIG_DESIGNWARE_WATCHDOG=y
CONFIG_WDT=y
CONFIG_WDT_MCOM03=y
```

## configs/ecam03dm_defconfig
```kconfig
CONFIG_ARM=y
CONFIG_ARCH_MCOM03=y
CONFIG_SYS_TEXT_BASE=0x890480000
CONFIG_SYS_MALLOC_F_LEN=0x4000
CONFIG_TARGET_MCOM03_ECAM03=y
CONFIG_ENV_SIZE=0x10000
CONFIG_ENV_OFFSET=0xFE0000
CONFIG_ENV_SECT_SIZE=0x10000
CONFIG_ARMV8_SET_SMPEN=y
CONFIG_DEFAULT_DEVICE_TREE="mcom03-ecam03dm-r1.0"
CONFIG_DISTRO_DEFAULTS=y
CONFIG_HAS_CUSTOM_SYS_INIT_SP_ADDR=y
CONFIG_CUSTOM_SYS_INIT_SP_ADDR=0x890800000
# CONFIG_DISPLAY_CPUINFO is not set
CONFIG_CMD_MEMINFO=y
CONFIG_CMD_GPT=y
# CONFIG_RANDOM_UUID is not set
CONFIG_MISC_INIT_R=y
CONFIG_CMD_MMC=y
CONFIG_CMD_MTD=y
CONFIG_CMD_SF_TEST=y
CONFIG_CMD_SPI=y
CONFIG_CMD_SQUASHFS=y
# CONFIG_ISO_PARTITION is not set
CONFIG_ENV_IS_IN_SPI_FLASH=y
CONFIG_NET_RANDOM_ETHADDR=y
CONFIG_DWAPB_GPIO=y
CONFIG_MMC_SDHCI=y
CONFIG_MMC_SDHCI_ADMA=y
CONFIG_MMC_SDHCI_MCOM03=y
CONFIG_MTD=y
CONFIG_DM_MTD=y
CONFIG_MTD_RAW_NAND=y
CONFIG_NAND_ARASAN=y
CONFIG_DM_SPI_FLASH=y
CONFIG_SPI_FLASH_SPANSION=y
CONFIG_PHY_MICREL=y
CONFIG_PHY_MICREL_KSZ90X1=y
CONFIG_ARASAN_GEMAC=y
CONFIG_DM_RESET=y
CONFIG_RESET_MCOM03=y
CONFIG_SYS_NS16550=y
CONFIG_SPI=y
CONFIG_DM_SPI=y
CONFIG_SILVACO_QSPI=y
CONFIG_DESIGNWARE_WATCHDOG=y
CONFIG_WDT=y
CONFIG_WDT_MCOM03=y
```

## configs/ipku_defconfig
```kconfig
CONFIG_ARM=y
CONFIG_SPL_SYS_THUMB_BUILD=y
CONFIG_ARCH_MCOM=y
CONFIG_SYS_TEXT_BASE=0x40000040
CONFIG_SPL_GPIO_SUPPORT=y
CONFIG_SPL_LIBCOMMON_SUPPORT=y
CONFIG_SPL_LIBGENERIC_SUPPORT=y
CONFIG_TARGET_IPKU=y
CONFIG_SPL_MMC_SUPPORT=y
CONFIG_SPL_SERIAL_SUPPORT=y
CONFIG_SPL=y
CONFIG_SPL_STACK_R_ADDR=0x40380000
CONFIG_SPL_LIBDISK_SUPPORT=y
CONFIG_SPL_SPI_FLASH_SUPPORT=y
CONFIG_SPL_SPI_SUPPORT=y
# CONFIG_LOCALVERSION_AUTO is not set
CONFIG_DISTRO_DEFAULTS=y
CONFIG_NR_DRAM_BANKS=2
# CONFIG_SYS_MALLOC_F is not set
CONFIG_SYS_CONSOLE_IS_IN_ENV=y
CONFIG_MISC_INIT_R=y
CONFIG_SPL_STACK_R=y
CONFIG_SYS_MMCSD_RAW_MODE_U_BOOT_USE_SECTOR=y
CONFIG_SYS_MMCSD_RAW_MODE_U_BOOT_SECTOR=0x102
CONFIG_SYS_PROMPT="mcom# "
# CONFIG_CMD_XIMG is not set
CONFIG_CMD_MEMINFO=y
# CONFIG_CMD_FLASH is not set
CONFIG_CMD_MMC=y
CONFIG_CMD_SF=y
CONFIG_CMD_USB=y
# CONFIG_CMD_NET is not set
CONFIG_CMD_CACHE=y
# CONFIG_CMD_MISC is not set
CONFIG_CMD_TIMER=y
CONFIG_CMD_UBI=y
CONFIG_OF_CONTROL=y
CONFIG_SPL_OF_CONTROL=y
CONFIG_DEFAULT_DEVICE_TREE="mcom02-ipku-r1.1"
CONFIG_ENV_IS_IN_SPI_FLASH=y
CONFIG_DM=y
CONFIG_SPL_DM=y
# CONFIG_DM_STDIO is not set
CONFIG_SPL_DM_SEQ_ALIAS=y
# CONFIG_SIMPLE_BUS is not set
# CONFIG_SPL_SIMPLE_BUS is not set
# CONFIG_OF_TRANSLATE is not set
CONFIG_DM_GPIO=y
CONFIG_DWAPB_GPIO=y
CONFIG_DM_MMC=y
CONFIG_MMC_SDHCI=y
CONFIG_MMC_SDHCI_MCOM=y
CONFIG_DM_SPI_FLASH=y
CONFIG_SPI_FLASH=y
CONFIG_SPI_FLASH_SPANSION=y
# CONFIG_SPI_FLASH_USE_4K_SECTORS is not set
CONFIG_SPI=y
CONFIG_DM_SPI=y
CONFIG_DESIGNWARE_SPI=y
CONFIG_USB=y
CONFIG_DM_USB=y
# CONFIG_REGEX is not set
# CONFIG_EFI_LOADER is not set
```

## configs/mcom03bub_defconfig
```kconfig
CONFIG_ARM=y
CONFIG_ARCH_MCOM03=y
CONFIG_SYS_TEXT_BASE=0x890480000
CONFIG_SYS_MALLOC_F_LEN=0x4000
CONFIG_TARGET_MCOM03=y
CONFIG_ENV_SIZE=0x10000
CONFIG_ENV_OFFSET=0xFE0000
CONFIG_ENV_SECT_SIZE=0x10000
CONFIG_ARMV8_SET_SMPEN=y
CONFIG_DEFAULT_DEVICE_TREE="mcom03-bub-r1.3.0"
CONFIG_DISTRO_DEFAULTS=y
CONFIG_HAS_CUSTOM_SYS_INIT_SP_ADDR=y
CONFIG_CUSTOM_SYS_INIT_SP_ADDR=0x890800000
# CONFIG_DISPLAY_CPUINFO is not set
CONFIG_BOARD_LATE_INIT=y
CONFIG_MISC_INIT_R=y
CONFIG_CMD_MEMINFO=y
CONFIG_CMD_GPT=y
# CONFIG_RANDOM_UUID is not set
CONFIG_CMD_I2C=y
CONFIG_CMD_MMC=y
CONFIG_CMD_SF_TEST=y
CONFIG_CMD_SPI=y
CONFIG_CMD_USB=y
CONFIG_CMD_CACHE=y
CONFIG_CMD_REGULATOR=y
# CONFIG_ISO_PARTITION is not set
CONFIG_ENV_IS_IN_SPI_FLASH=y
CONFIG_NET_RANDOM_ETHADDR=y
CONFIG_DWAPB_GPIO=y
CONFIG_DM_I2C=y
CONFIG_SYS_I2C_DW=y
CONFIG_MMC_IO_VOLTAGE=y
CONFIG_MMC_SDHCI=y
CONFIG_MMC_SDHCI_ADMA=y
CONFIG_MMC_SDHCI_MCOM03=y
CONFIG_DM_SPI_FLASH=y
CONFIG_SPI_FLASH_SPANSION=y
CONFIG_PHY_MICREL=y
CONFIG_PHY_MICREL_KSZ90X1=y
CONFIG_ARASAN_GEMAC=y
CONFIG_DM_REGULATOR=y
CONFIG_DM_REGULATOR_FIXED=y
CONFIG_DM_RESET=y
CONFIG_RESET_MCOM03=y
CONFIG_SYS_NS16550=y
CONFIG_SPI=y
CONFIG_DM_SPI=y
CONFIG_SILVACO_QSPI=y
CONFIG_USB=y
CONFIG_DM_USB=y
CONFIG_USB_XHCI_HCD=y
CONFIG_USB_XHCI_DWC3=y
CONFIG_USB_XHCI_DWC3_OF_SIMPLE=y
CONFIG_USB_HOST_ETHER=y
CONFIG_USB_ETHER_RTL8152=y
CONFIG_DESIGNWARE_WATCHDOG=y
CONFIG_WDT=y
CONFIG_WDT_MCOM03=y
```

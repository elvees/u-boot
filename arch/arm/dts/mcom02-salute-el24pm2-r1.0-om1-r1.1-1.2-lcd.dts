/*
 * Copyright 2017 RnD Center "ELVEES", JSC
 *
 * This program is free software; you can redistribute it and/or modify
 * it under the terms of the GNU General Public License version 2 as
 * published by the Free Software Foundation.
 */

/dts-v1/;

#include "mcom02-salute-el24pm2-r1.0-om1-r1.1-1.2.dtsi"
#include "mcom02-salute-el24om1-lcd-common.dtsi"

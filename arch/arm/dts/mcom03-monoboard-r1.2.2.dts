// SPDX-License-Identifier: GPL-2.0+
// Copyright 2024 RnD Center "ELVEES", JSC

/dts-v1/;

#include "mcom03-monoboard-r1.1.1.dts"

/ {
	model = "MCom-03 MONO-BOARD r1.2.2";
	compatible = "elvees,monoboard-r1.2.2",
		     "elvees,monoboard",
		     "elvees,mcom03";
};

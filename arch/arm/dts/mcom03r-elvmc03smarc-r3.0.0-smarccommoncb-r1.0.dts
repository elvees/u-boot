// SPDX-License-Identifier: GPL-2.0+
// Copyright 2025 RnD Center "ELVEES", JSC

/dts-v1/;

#include "mcom03r-elvmc03smarc-r3.0.0.dtsi"
#include "mcom03-smarccommoncb-r1.0.dtsi"

/ {
	model = "ELV-MC03-SMARC r3.0.0, SMARC-COMMON-CB r1.0";
	compatible = "elvees,elvmc03smarc-r3.0.0-smarccommoncb-r1.0",
		     "elvees,elvmc03smarc-smarccommoncb",
		     "elvees,smarccommoncb-r1.0",
		     "elvees,smarccommoncb",
		     "elvees,elvmc03smarc-r3.0.0",
		     "elvees,elvmc03smarc",
		     "elvees,mcom03r";

	chosen {
		stdout-path = "serial0:115200n8";
	};
};

&sdhci1 {
	/* The default pad drive strength of 6 mA is insufficient for
	 * SMARC-UKF-TFK r1.1.1 resulting in unstable SDMMC performance,
	 * especially at lower board temperatures(MCOM03SW-4269).
	 */
	elvees,drive-strength-clk = <10>;
	elvees,drive-strength-dat = <8>;
	elvees,drive-strength-cmd = <8>;
};

/*
 * Copyright 2017 RnD Center "ELVEES", JSC
 *
 * This program is free software; you can redistribute it and/or modify
 * it under the terms of the GNU General Public License version 2 as
 * published by the Free Software Foundation.
 */

/ {
	at070tn92: lcd-display {
		bits-per-pixel = <24>;
		bus-width = <24>;

		display-timings {
			800x480p60 {
				clock-frequency = <33300000>;
				hactive = <800>;
				vactive = <480>;
				hfront-porch = <85>;
				hback-porch = <85>;
				hsync-len = <86>;
				vback-porch = <15>;
				vfront-porch = <15>;
				vsync-len = <15>;
				hsync-active = <0>;
			};
		};
	};
};
